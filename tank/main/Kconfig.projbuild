## tank/main/Kconfig.projbuild
```kconfig
menu "Tank Config"

    config TANK_WIFI_SSID
        string "Wi-Fi SSID"
        default "iot-tank-arena"

    config TANK_WIFI_PASSWORD
        string "Wi-Fi password"
        default "iot-tank-passwd"

    config TANK_SERVER_HOST
        string "Server host and port"
        default "10.42.0.2:8000"

    config TANK_ID
        int "Tank ID"
        range 1 2
        default 1

endmenu
```
