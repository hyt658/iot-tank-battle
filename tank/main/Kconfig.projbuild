## tank/main/Kconfig.projbuild
```kconfig
menu "Tank Config"

    config TANK_WIFI_SSID
        string "Wi-Fi SSID"
        default "iot-tank-arena"

    config TANK_WIFI_PASSWORD
        string "Wi-Fi password"
        default ""

    config TANK_SERVER_URI
        string "Server WebSocket URI"
        default "ws://192.168.2.1:8000/ws/tank"

    config TANK_ID
        int "Tank ID"
        range 1 2
        default 1

endmenu
```

## tank/sdkconfig.defaults
```kconfig
CONFIG_IDF_TARGET="esp32s3"
CONFIG_ESPTOOLPY_FLASHSIZE_8MB=y
CONFIG_SPIRAM=y
CONFIG_SPIRAM_MODE_OCT=y
CONFIG_PARTITION_TABLE_TWO_OTA_LARGE=y
```
